## scripts/kconfig/Kconfig
```kconfig
mainmenu "Firmware set"

config FIRMWARE_VERSION
    string "设置固件版本号"
    default "H00-x.x.x"

choice
    prompt "版本选择"
    default FIRMWARE_NONE

config FIRMWARE_NONE
    bool "None"
    help
        用户自定义

config FIRMWARE_F01
    bool "使用 F01 固件配置"
    select ENABLE_SLEEP
    select ENABLE_VERIFY
    select ENABLE_USB_CDC
    help
        使用 F01 固件配置

config FIRMWARE_F02
    bool "使用 F02 固件配置"
    select ENABLE_SLEEP
    select ENABLE_VERIFY
    select ENABLE_USB_CDC
    help
        使用 F02 固件配置

endchoice

menu "固件配置"

config ENABLE_SLEEP
    bool "启用休眠功能"
    default y
    help
        Will print debug information

config ENABLE_VERIFY
    bool "启用身份验证"
    default y
    help
        启用身份验证

menuconfig DEBUG
    bool "启用系统日志"
    default n
    depends on FIRMWARE_NONE
    help
        Will print debug information

if DEBUG

config DEBUG_COLOR_MODE
    bool "开启日志颜色"
    default y
    help
      Enable this option to colorize logs for easier reading.

config DEBUG_LEVEL
    hex "日志等级"
    default 0x04
    range 0x00 0x04
    help
      Enable this option to print verbose debugging information.

endif

menuconfig ENABLE_USB_CDC
    bool "启用 USB CDC 功能"
    default y
    help
        note ...

if ENABLE_USB_CDC

config ENABLE_USB_DBG
    bool "启用 USB 日志"
    default n
    depends on FIRMWARE_NONE
    help
        note ...

endif

config ENABLE_PROACTIVE_NOTIFY
    bool "启用蓝牙消息主动上报功能"
    default n
    depends on FIRMWARE_NONE
    help
        主动上报开锁结果

endmenu
```

## scripts/kconfig/kconfig
```kconfig
mainmenu "BSL_LOCK Kconfig Demo"

menu "锁固件配置"
config MY_DEBUG
    bool "启用系统日志"
    default n
    help
        Will print debug information

config COLOR_LOG_MODE
    bool "开启日志颜色"
    default n
    help
        Will print debug information

config ENABLE_SLEEP
    bool "启用休眠功能"
    default n
    help
        Will print debug information

config ENABLE_VERIFY
    bool "启用身份验证"
    default n
    help
        关闭验证时蓝牙名称更改为 BLE-TEST_BSL

config ENABLE_USB_CDC_DBG
    bool "启用 USB 日志"
    default n
    help
        note ...

config ENABLE_USB_CDC
    bool "启用 USB CDC 功能"
    default n
    help
        note ...

config ENABLE_PROACTIVE_NOTIFY
    bool "启用蓝牙消息主动上报功能"
    default n
    help
        主动上报开锁结果

config FIRMWARE_VERSION
    string "设置固件版本号"
    default "H02-1.0.0"

# config TEST_SHOW_INT
#     int "The show int info"
# 	range 0 255
#     default 123

# config TEST_TOP_ENABLE
# 	bool "Test Top Func"
#     default n
#     help
#         Function Test Top

# config TEST_SUB_0_ENABLE
# 	bool "Test Sub 0 Func"
#     default n
#     help
#         Function Test Sub 0

# config TEST_SUB_1_ENABLE
# 	bool "Test Sub 1 Func"
#     default n
#     depends on TEST_TOP_ENABLE
#     help
#         Function Test Sub 1

# config TEST_SHOW_SUB_INT
#     int
#     default 456 if TEST_SUB_0_ENABLE && TEST_SUB_1_ENABLE
#     default 123

endmenu
```
